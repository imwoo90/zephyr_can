## boards/olimex_stm32_h405.conf
```kconfig
CONFIG_SHELL=y
CONFIG_UART_CONSOLE=n

CONFIG_USE_SEGGER_RTT=y
CONFIG_SHELL_BACKEND_RTT=y

CONFIG_CAN_SHELL=n

CONFIG_SPI=y
# CONFIG_SPI_STM32_DMA=y
CONFIG_SPI_STM32_INTERRUPT=y
CONFIG_SPI_STM32_USE_HW_SS=n
```
